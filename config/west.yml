## config/west.yml
```yaml
manifest:
  remotes:
    - name: zmkfirmware
      url-base: https://github.com/zmkfirmware
    - name: SethMilliken
      url-base: https://github.com/SethMilliken
    - name: caksoylar
      url-base: https://github.com/caksoylar
    - name: davidphilipbarr
      url-base: https://github.com/davidphilipbarr
  projects:
    - name: zmk
      #remote: zmkfirmware
      #revision: main
      remote: SethMilliken
      revision: experimental-blend  # custom branch name
      #remote: caksoylar
      #revision: caksoylar/zen-v1+v2+experimental  # custom branch name
      import: app/west.yml
    - name: nicehatharry
      remote: SethMilliken
      clone-depth: 1
      revision: main
  self:
    path: config
```
